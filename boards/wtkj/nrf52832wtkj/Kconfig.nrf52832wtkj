## boards/wtkj/nrf52832wtkj/nrf52832wtkj_defconfig
```kconfig
CONFIG_ARM_MPU=y
CONFIG_HW_STACK_PROTECTION=y

# 使能RTT
CONFIG_USE_SEGGER_RTT=y

# 使能 gpio
CONFIG_GPIO=y

#使能uart驱动
CONFIG_SERIAL=y

#使能 console
CONFIG_CONSOLE=y
CONFIG_UART_CONSOLE=y
```
